# file: Assembly_C_and_Optimization.ioc
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Mcu.Family=STM32L4
Mcu.Name=STM32L475V(C-E-G)Tx
Mcu.Package=LQFP100
NVIC.PriorityGroup=NVIC_PRIORITYGROUP_4
PB3\ (JTDO-TRACESWO).GPIO_Label=SWO
PB3\ (JTDO-TRACESWO).Signal=SYS_JTDO-SWO
ProjectManager.HeapSize=0x200
ProjectManager.StackSize=0x400
ProjectManager.TargetToolchain=STM32CubeIDE
RCC.ADCFreq_Value=48000000
RCC.AHBFreq_Value=80000000
RCC.APB1Freq_Value=80000000
RCC.APB1TimFreq_Value=80000000
RCC.APB2Freq_Value=80000000
RCC.APB2TimFreq_Value=80000000
RCC.CortexFreq_Value=80000000
RCC.HCLKFreq_Value=80000000
RCC.HSE_VALUE=8000000
RCC.HSI_VALUE=16000000
RCC.MSI_VALUE=4000000
RCC.PLLN=40
RCC.PLLSAI1N=24
RCC.SYSCLKFreq_VALUE=80000000
RCC.SYSCLKSource=RCC_SYSCLKSOURCE_PLLCLK
RCC.USBFreq_Value=48000000
RCC.VCOOutputFreq_Value=160000000
board=B-L475E-IOT01A2

// file: Core/Src/main.c
/* USER CODE BEGIN Header */
/**
  ******************************************************************************
  * @file           : main.c
  * @brief          : Main program body
  ******************************************************************************
  * @attention
  *
  * Copyright (c) 2023 STMicroelectronics.
  * All rights reserved.
  *
  * This software is licensed under terms that can be found in the LICENSE file
  * in the root directory of this software component.
  * If no LICENSE file comes with this software, it is provided AS-IS.
  *
  ******************************************************************************
  */
/* USER CODE END Header */
#include "main.h"

/* USER CODE BEGIN PD */
#define ITM_Port32(n) (*((volatile unsigned long *) (0xE0000000+4*n)))
/* USER CODE END PD */

void SystemClock_Config(void);
static void MX_GPIO_Init(void);

int main(void)
{

  /* MCU Configuration--------------------------------------------------------*/

  /* Reset of all peripherals, Initializes the Flash interface and the Systick. */
  HAL_Init();

  /* Configure the system clock */
  SystemClock_Config();

  /* Initialize all configured peripherals */
  MX_GPIO_Init();
  /* USER CODE BEGIN 2 */
  //////////////////////////////TEST Find Max in Array//////////////////////////////
  float max = 0;
  uint32_t maxIndex;
  float array[11] = {48.21, 79.48, 48.21, 24.27, 28.82, 78.24, 88.49, 31.19, 5.52, 82.70, 77.73}; // the max is 88.49 at index 6
  uint32_t len_array = sizeof(array) / sizeof(array[0]);
  //////////////////////////////TEST Calculate Square Root//////////////////////////////
  float32_t in = 15;
  float32_t sqrt_in;
  //////////////////////////////TEST Solve Transcendental Function//////////////////////////////
  float32_t omega = 25;
  float32_t phi = 5;
  float32_t x;

  /* USER CODE END 2 */

  /* Infinite loop */
  while (1)
  {

    /* USER CODE BEGIN 3 */
	  /*
	   * ITM_Port32(n) is a location in memory; setting it to a value will generate a trace
	   * packet with that value as the data. This also generates a time stamp in terms of
	   * elapsed cycle count and wall-clock time. Because the debugging interface has
	   * limited bandwidth, we need to take measures to intentionally spread out when
	   * trace packets are generated (e.g. by putting the test function inside a repeating
	   * loop). In other words, a single execution does not give enough time to
	   * measure the delay.
	   * The code below sends data values 1 and 2 to ITM port 31; the time stamp for value
	   * 1 indicates the approximate start time, and for value 2, the approximate end time,
	   * of the execution of 1000 calls to the function. The values are approximate because
	   * it takes time to write to the ITM port, and using a for loop to time 1000 iterations
	   * of the function introduces overhead.
	   */

	  //////////////////////////////TEST findMax//////////////////////////////
	  ITM_Port32(31) = 1;
	  for (uint32_t i=0; i<1000; i++)
	  {
		  findMax(array, len_array, &max, &maxIndex);
	  }
	  ITM_Port32(31) = 2;

	  //////////////////////////////TEST findMaxAsm//////////////////////////////
	  ITM_Port32(31) = 3;
	  for (uint32_t i=0; i<1000; i++)
	  {
		  findMaxAsm(array, len_array, &max, &maxIndex);
	  }
	  ITM_Port32(31) = 4;

	  ////////////////////////////TEST arm_max_f32//////////////////////////////
	  ITM_Port32(31) = 5;
	  	  for (uint32_t i=0; i<1000; i++)
	  	  {
	  		arm_max_f32(array, len_array, &max, &maxIndex);
	  	  }
	  ITM_Port32(31) = 6;

	  ////////////////////////////TEST arm_sqrt_f32//////////////////////////////
	  ITM_Port32(31) = 7;
		  for (uint32_t i=0; i<1000; i++)
		  {
			arm_sqrt_f32(in, &sqrt_in);
		  }
	  ITM_Port32(31) = 8;

	  ////////////////////////TEST findSqrt//////////////////////////////
	  ITM_Port32(31) = 9;
		  for (uint32_t i=0; i<1000; i++)
		  {
			  findSqrt(in, &sqrt_in);
		  }
	  ITM_Port32(31) = 10;

	  //////////////////////////TEST findSqrtAsm//////////////////////////////
	  ITM_Port32(31) = 11;
		  for (uint32_t i=0; i<1000; i++)
		  {
			  findSqrtAsm(in, &sqrt_in);
		  }
	  ITM_Port32(31) = 12;

	  ////////////////////////////TEST findTranscendental//////////////////////////////
	  ITM_Port32(31) = 13;
		  for (uint32_t i=0; i<1000; i++)
		  {
			  findTranscendental(omega, phi, &x);
		  }
	  ITM_Port32(31) = 14;

	  ITM_Port32(31) = 15;
		  for (uint32_t i=0; i<1000; i++)
		  {
			  findTranscendentalAsm(omega, phi, &x);
		  }
	  ITM_Port32(31) = 16;
  }

  /* USER CODE END 3 */
}

void SystemClock_Config(void)
{
  RCC_OscInitTypeDef RCC_OscInitStruct = {0};
  RCC_ClkInitTypeDef RCC_ClkInitStruct = {0};

  /** Configure the main internal regulator output voltage
  */
  if (HAL_PWREx_ControlVoltageScaling(PWR_REGULATOR_VOLTAGE_SCALE1) != HAL_OK)
  {
    Error_Handler();
  }

  /** Initializes the RCC Oscillators according to the specified parameters
  * in the RCC_OscInitTypeDef structure.
  */
  RCC_OscInitStruct.OscillatorType = RCC_OSCILLATORTYPE_MSI;
  RCC_OscInitStruct.MSIState = RCC_MSI_ON;
  RCC_OscInitStruct.MSICalibrationValue = 0;
  RCC_OscInitStruct.MSIClockRange = RCC_MSIRANGE_6;
  RCC_OscInitStruct.PLL.PLLState = RCC_PLL_ON;
  RCC_OscInitStruct.PLL.PLLSource = RCC_PLLSOURCE_MSI;
  RCC_OscInitStruct.PLL.PLLM = 1;
  RCC_OscInitStruct.PLL.PLLN = 40;
  RCC_OscInitStruct.PLL.PLLP = RCC_PLLP_DIV7;
  RCC_OscInitStruct.PLL.PLLQ = RCC_PLLQ_DIV2;
  RCC_OscInitStruct.PLL.PLLR = RCC_PLLR_DIV2;
  if (HAL_RCC_OscConfig(&RCC_OscInitStruct) != HAL_OK)
  {
    Error_Handler();
  }

  /** Initializes the CPU, AHB and APB buses clocks
  */
  RCC_ClkInitStruct.ClockType = RCC_CLOCKTYPE_HCLK|RCC_CLOCKTYPE_SYSCLK
                              |RCC_CLOCKTYPE_PCLK1|RCC_CLOCKTYPE_PCLK2;
  RCC_ClkInitStruct.SYSCLKSource = RCC_SYSCLKSOURCE_PLLCLK;
  RCC_ClkInitStruct.AHBCLKDivider = RCC_SYSCLK_DIV1;
  RCC_ClkInitStruct.APB1CLKDivider = RCC_HCLK_DIV1;
  RCC_ClkInitStruct.APB2CLKDivider = RCC_HCLK_DIV1;

  if (HAL_RCC_ClockConfig(&RCC_ClkInitStruct, FLASH_LATENCY_4) != HAL_OK)
  {
    Error_Handler();
  }
}

static void MX_GPIO_Init(void)
{

  /* GPIO Ports Clock Enable */
  __HAL_RCC_GPIOB_CLK_ENABLE();

}

void Error_Handler(void)
{
  __disable_irq();
  while (1)
  {
  }
}
